## main/Kconfig.projbuild
```kconfig
menu "EKG Monitor"

    config EKG_ONBOARD_SERVER
        bool
        default y
        select HTTPD_WS_SUPPORT
        select HTTPD_WS_POST_HANDSHAKE_CB_SUPPORT

    config EKG_DEVICE_ID
        string "Geräte-ID"
        default "esp32-01"
        help
            1–64 Zeichen: A-Z, a-z, 0-9, Punkt, Unterstrich oder Bindestrich.

    config EKG_SAMPLE_RATE_HZ
        int "Abtastrate (Hz)"
        default 250
        range 50 1000

    config EKG_SAMPLES_PER_PACKET
        int "Samples pro Paket"
        default 25
        range 5 200

    config EKG_USE_TEST_SIGNAL
        bool "Eingebautes Testsignal statt ADC verwenden"
        default y
        help
            Erzeugt ein einfaches synthetisches EKG auf dem ESP32 selbst.
            Praktisch, solange noch keine Elektroden angeschlossen sind.

    config EKG_ADC_GPIO
        int "ADC-Eingang (GPIO, nur ADC1: 32-39)"
        default 34
        range 32 39

    config EKG_LO_PLUS_GPIO
        int "Lead-off LO+ (GPIO, -1 = nicht verwendet)"
        default 32

    config EKG_LO_MINUS_GPIO
        int "Lead-off LO- (GPIO, -1 = nicht verwendet)"
        default 33

endmenu
```
